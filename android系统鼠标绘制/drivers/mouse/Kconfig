## android系统鼠标绘制/drivers/mouse/Kconfig
```kconfig
config MOUSE
    tristate "Mouse Register Driver"
    default n
    help
    This is the mouse position driver for android system
```

## android系统鼠标绘制/drivers/mouse_poll/Kconfig
```kconfig
config MOUSE
    tristate "Mouse Register Driver"
    default m
    help
    This is the mouse position driver for android system
```
